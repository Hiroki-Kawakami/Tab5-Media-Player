## esp32p4oc/sdkconfig.defaults
```kconfig
CONFIG_PARTITION_TABLE_CUSTOM_FILENAME="../esp32p4/partitions.csv"
CONFIG_ESP_DEFAULT_CPU_FREQ_MHZ_400=y
CONFIG_SPIRAM_SPEED_220M=y
```

## simulator/sdkconfig.defaults
```kconfig
CONFIG_BSP_BOARD_TAB5=y
CONFIG_USBH_MSC=y
CONFIG_USBH_UAC=y
CONFIG_USBH_UVC=y
CONFIG_LV_FONT_MONTSERRAT_20=y
CONFIG_LV_FONT_MONTSERRAT_24=y
CONFIG_LV_FONT_MONTSERRAT_28=y
CONFIG_LV_FONT_MONTSERRAT_32=y
CONFIG_LV_FONT_MONTSERRAT_38=y
CONFIG_LV_FONT_MONTSERRAT_48=y
```
